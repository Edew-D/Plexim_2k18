/*****************************************************************
** PIL Framework information created by pilpreptool from reading
** - ./output/pwm_2806x.pilpp
** - ./output/ain_2806x.pilpp
** - ./output/dio_2806x.pilpp
** - ./output/qep_2806x.pilpp
** - ./output/dispatcher_2806x.pilpp
** - ./output/gatedriver_rtbox.pilpp
** - ./output/power.pilpp
** - ./output/hal_2806x.pilpp
** - ./output/pu.pilpp
** - ./output/calib.pilpp
** - ./output/pil_ctrl.pilpp
** - ./output/main.pilpp
** - ./output/sci.pilpp
** - ./output/Target28069_Blink.pilpp
**
** WARNING! All changes made in this file will be lost!
*****************************************************************/


#error Error during parsing of './output/pwm_2806x.pilpp': syntax error in line 7293 before '}'
#error Error during parsing of './output/ain_2806x.pilpp': syntax error in line 7289 before '}'
#error Error during parsing of './output/dio_2806x.pilpp': syntax error in line 7293 before '}'
#error Error during parsing of './output/qep_2806x.pilpp': syntax error in line 7292 before '}'
#error Error during parsing of './output/dispatcher_2806x.pilpp': syntax error in line 7294 before '}'
#error Error during parsing of './output/gatedriver_rtbox.pilpp': syntax error in line 7289 before '}'
#error Error during parsing of './output/power.pilpp': syntax error in line 7293 before '}'
#error Error during parsing of './output/hal_2806x.pilpp': syntax error in line 7290 before '}'
#error Error during parsing of './output/calib.pilpp': syntax error in line 7289 before '}'
#error Error during parsing of './output/pil_ctrl.pilpp': syntax error in line 7270 before '}'
#error Error during parsing of './output/main.pilpp': syntax error in line 7270 before '}'
#error Error during parsing of './output/sci.pilpp': syntax error in line 7289 before '}'
#error Error during parsing of './output/Target28069_Blink.pilpp': syntax error in line 197 before '}'
